// ************************************************
//
// XLINK configuration file for MSP430F5528
//
// Copyright 1996-2010 IAR Systems AB
//
// $Revision: $
//
// ************************************************

// ---------------------------------------------------------
// Description
//

//
// Usage:
//
//   xlink [file file ...] -f lnk430f6638.xcl
//
// -----------------------------------------------
// Device summary
//

//
// Core:                           MSP430X
//
// Interrupt vectors:              64
//
// Peripheral units:                   0-001FF
//
// Information memory (FLASH):     01800-019FF
//
// Read/write memory (RAM):        02400-063FF
//
// Read-only memory (FLASH):       08000-0FFFF
//                                 10000-47FFF
//


// -----------------------------------------------
// Segments
//

// -------------------------------------
// Data read/write segments (RAM)
//

//
// The following segments are available for both
// the DATA16 and DATA20 segment groups.
//
// segment         Usage
// -------         --------------------------
// DATA<nn>_Z      Data initialized to zero
// DATA<nn>_I      Data initialized by copying from DATA<nn>_ID
// DATA<nn>_N      Data defined using __no_init
// DATA<nn>_HEAP   The heap used by 'malloc' and 'free'
//
// segment         Usage
// -------         --------------------------
// CSTACK          Runtime stack
//


// -------------------------------------
// Program and data read-only segments (FLASH)
//

//
// The following segments are available for both
// the DATA16 and DATA20 segment groups.
//
// segment         Usage
// -------         --------------------------
// DATA<nn>_C      Constant data, including string literals
// DATA<nn>_ID     initializers for DATA<nn>_I
//
// segment         Usage
// -------         --------------------------
// INFO            Information memory
// INFOA           Information memory, bank A
// INFOB           Information memory, bank B
// INFOC           Information memory, bank C
// INFOD           Information memory, bank D
// CSTART          Program startup code
// CODE            Program code
// ISR_CODE        Program code for interrupt service routines
// DIFUNCT         Dynamic initialization vector used by C++
// CHECKSUM        Checksum byte(s) generated by the -J option
// INTVEC          Interrupt vectors
// RESET           The reset vector
//
// Notes:
//
// * The segments CSTART, ISR_CODE, and DIFUNCT, as well as the segments in
//   the DATA16 segment group must be placed in in the range 0000-FFFD.
//
// * The INFOx and INFO segments overlap, this allows data either to be
//   placed in a specific bank or anywhere in the info memory.
//
// * The INTVEC and RESET segments overlap. This allows an application to
//   either use the reset vector provided by the runtime library, or
//   provide a reset function by defining an interrupt function associated
//   with the reset vector.
//


// ---------------------------------------------------------
// Configuation
//

// -----------------------------------------------
// Stack and heap sizes
//

// Uncomment for command line use
-D_STACK_SIZE=120
-D_DATA16_HEAP_SIZE=80
-D_DATA20_HEAP_SIZE=210


// -----------------------------------------------
// Define cpu
//

-cmsp430

// -----------------------------------------------
// Support for placing functions in read/write memory
//
-QCODE_I=CODE_ID

// ---------------------------------------------------------
// Placement directives
//

// -----------------------------------------------
// Read/write memory
//
-Z(DATA)DATA16_I,DATA16_Z,DATA16_N,DATA16_HEAP+_DATA16_HEAP_SIZE=3000-40FF
-Z(DATA)CODE_I
-Z(DATA)DATA20_I,DATA20_Z,DATA20_N,DATA20_HEAP+_DATA20_HEAP_SIZE=3000-40FF
-Z(DATA)CSTACK+_STACK_SIZE#

-Z(DATA)SHARED_VARIABLES=4100-41FF
// -----------------------------------------------
// Read-only memory
//
// -------------------------------------
// Information memory
//

-Z(CONST)INFO=1800-19FF
-Z(CONST)INFOA=1980-19FF
-Z(CONST)INFOB=1900-197F
-Z(CONST)INFOC=1880-18FF
-Z(CONST)INFOD=1800-187F

-Z(CONST)COREVERSION=4404-4405

-Z(CODE)TOOLID=4400-4401
-Z(CONST)DATA16_C,DATA16_ID,DIFUNCT,CHECKSUM=4402-4403
-Z(CONST)HILSIGNATURE=18FC-18FF
-Z(CONST)HILINIT=18F8-18FA


// -------------------------------------
// Low memory 0-0FFFF
//
// ---------------------------
// Code
//

-Z(CODE)CSTART,ISR_CODE=4406-89FF
-h(CODE)4400-89FF

// ---------------------------
// Constant data
//
// -------------------------------------
// All memory 0-FFFFF
//

// ---------------------------------------------------------
// HAL Interrupt vectors
// ---------------------------------------------------------


// ---------------------------
// Code
//

-P(CODE)CODE=4402-89FF
-Z(CODE)CODE_ID
-h(CODE)4402-89FF

-Z(CONST)HALINTVEC=1900-1903
-Z(CONST)HALSIGNATURE=197C-197F

-Z(CONST)DCDCIVEC=1800-1803
-Z(CONST)DCDCSIGNATURE=187C-187F

-Z(CONST)COMINTVEC=1980-1983         // Information Memory A for UART
-Z(CONST)COMSIGNATURE=19FC-19FF      // in Main memory

// ---------------------------
// Constant data
//

-Z(CONST)DATA20_C,DATA20_ID=4402-89FF


// -------------------------------------
// BIOS Interrupt vectors
//

-Z(CODE)INTVEC=FF80-FFFF
-Z(CODE)RESET=FFFE-FFFF
-h(CODE)FF80-FFFF
// -------------------------------------
// Identfiers
//



